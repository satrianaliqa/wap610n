## kernel/linux-2.6.16-star/drivers/net/str9100/Kconfig
```kconfig
menu "STAR Gigabit Switch support"
	depends on ARCH_STR9100

config STAR_GSW
	tristate "STAR Gigabit Switch driver support"

choice
	prompt "STAR Board"
	depends on STAR_GSW
	default DORADO

config DORADO
	bool "Dorado"

config DORADO2
	bool "Dorado2"

config VIRGO
	bool "Virgo"

config VELA
	bool "Vela"

config LIBRA
	bool "Libra"
	help
		Board configuration Libra(one arm mode):
			Cooperate with IC+175C - 5 port 10/100 ethernet integrated switch.
			Configure as two VLANs, one for WAN and another for LAN. Tag base 
			VLAN transfer with VLAN tag. The IC+175C connects to MAC0 only.

config LIBRA2
	bool "Libra2"
	help
		Board configuration Libra2(two arm mode):
			Cooperate with IC+175C - 5 port 10/100 ethernet integrated switch.
			Port based VLAN transfer without VLAN tag. The IC+175C PHY0~PHY3
			connects to MAC0, PHY4 connects to MAC1.

config U_MEDIA
	bool "Umedia"
	help
		Board configuration U-Media:
			Based on Vela board configuration, enriched by U-Media specific changes.

config LEO
	bool "Leo"

config GPB239M
	bool "GPB239M"
	help
		Board configuration GPB239M:
			Based on Libra board configuration, Master side of GPB 239 (GPB9102).

config GPB239S
	bool "GPB239S"
	help
		Board configuration GPB239S:
			Based on Vela board configuration, Slaveside of GPB 239 (GPB9109).

config GPB261
	bool "GPB261"
	help
		Board configuration GPB261:
			Based on GPB237 board configuration, enriched by additional MAC port and one MII through a ribbon cable, for integrating in STBs that use STAR as the external ethernet.

config GPB261_PHY_CONNECTOR
	bool "GPB261_PHY_CONNECTOR"
	help
		Board configuration GPB261 with phy connector:
			Based on GPB237 board configuration, enriched by additional MAC port. Special configuration for phy connector.

config GPB262
	bool "GPB262"
	help
		Board configuration GPB262:
			Based on GPB237 board configuration, with MII interface provided through a PCI connector, for integrating in STBs.


endchoice

config STR9100_SHNAT
	bool "STAR Smart HNAT Support"
	depends on STAR_GSW
	help
	  Add STAR Smart HNAT support function in kernel

config STAR9100_SHNAT_PCI_FASTPATH
	bool "   FastPath(From PCI to WAN) Support"
	depends on STR9100_SHNAT
	help
      Add FastPath Support for Smart HNAT.

config STAR_NIC_PARAM_FROM_MTD
	bool "Read required parameter from flash"
	default n
	
config STAR_NIC_PARAM_MTD_DEVNUM
	int "MTD env devnum"
	depends on STAR_NIC_PARAM_FROM_MTD
	default 1

config STAR_NIC_PARAM_MTD_OFFSET
	hex "MTD env offset"
	depends on STAR_NIC_PARAM_FROM_MTD
	default 0x20000

config STAR_NIC_PARAM_MTD_SIZE
	hex "MTD env size"
	depends on STAR_NIC_PARAM_FROM_MTD
	default 0x10000

config STAR_NIC_PARAM_MAC_KEYWORD
	string "MTD env entry keyword"
	depends on STAR_NIC_PARAM_FROM_MTD
	default "ethaddr="

config STAR_NIC_PARAM_MAC_VALUE_END
	hex "MTD env entry end character in hex"
	depends on STAR_NIC_PARAM_FROM_MTD
	default "0x0"
endmenu
```
